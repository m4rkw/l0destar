## CMakeLists.txt
```
# SPDX-License-Identifier: Apache-2.0

cmake_minimum_required(VERSION 3.20.0)
find_package(Zephyr REQUIRED HINTS $ENV{ZEPHYR_BASE})
project(l0destar)

# The receiver: the nRF9151's own (gnss.c, and the nRF Cloud A-GNSS that feeds
# it) or, on a board that has one, the external u-blox on its own UART.
if(CONFIG_APP_BOARD_HAS_EXT_GNSS)
    set(GNSS_SOURCES src/gnss_ext.c src/gnss_ubx.c src/gnss_nmea.c)
    if(CONFIG_APP_ASSISTNOW)
        list(APPEND GNSS_SOURCES src/assistnow.c)
    endif()
else()
    set(GNSS_SOURCES src/gnss.c src/agnss.c)
endif()

target_sources(app PRIVATE
    src/main.c
    src/crypto.c
    src/settings.c
    src/tunables.c
    src/hw_common.c
    src/hw_domain.c
    src/hw_selftest.c
    src/hw_power.c
    src/hw_can.c
    src/hw_accel.c
    src/hw_kline.c
    ${GNSS_SOURCES}
    src/modem.c
    src/data.c
    src/alert.c
    src/commands.c
    src/reports.c
    src/fota.c
    src/led.c
    src/watchdog.c
    src/isr_mark.c
    src/modem_call_mark.c
    src/reboot.c
    src/fatal.c
)

# Telemetry transport: the l0destar server's encrypted UDP, or a Traccar
# server's OsmAnd HTTP.  Both implement the transport_* interface in app.h.
if(CONFIG_APP_TRACCAR)
    target_sources(app PRIVATE src/traccar.c)
else()
    target_sources(app PRIVATE src/transport.c)
endif()

# Installation mode (src/install.c; pure parts in install_core.h).
target_sources_ifdef(CONFIG_APP_INSTALL_MODE app PRIVATE src/install.c)

# Interactive bring-up rig (board_test.sh) — bench builds only.
target_sources_ifdef(CONFIG_APP_BOARD_TEST app PRIVATE src/board_test.c)

# CAN bench-test agent (can_bench/) — bench builds only.
target_sources_ifdef(CONFIG_APP_CAN_BENCH app PRIVATE src/can_bench.c)

# LTE TX power / brown-out rig — bench builds only.
target_sources_ifdef(CONFIG_APP_LTE_POWER_TEST app PRIVATE src/lte_power_test.c)

# Backlog buffer for records that could not be sent.
target_sources(app PRIVATE src/databuf.c)
# Its overflow on an external flash: the wear-levelled log (host-tested in
# tests/test_flashlog.py) and the MX25R6435F driver under it.  The driver is
# built wherever the board has the chip, backlog or not: it puts the chip into
# deep power-down at boot, and a chip nobody parks sits in standby.
target_sources_ifdef(CONFIG_APP_FLASH_BACKLOG app PRIVATE src/flashlog.c)
target_sources_ifdef(CONFIG_APP_BOARD_HAS_EXT_FLASH app PRIVATE src/extflash.c)
# Warnings/errors captured for the server (see src/dbglog.c).
target_sources_ifdef(CONFIG_APP_DEBUG_LOG app PRIVATE src/dbglog.c)

# Demo mode's coordinate masker for the console (either receiver).
target_sources_ifdef(CONFIG_APP_DEMO_MODE app PRIVATE src/demo_mask.c)

# The motion through gaps between GNSS fixes (see src/motion.c).
target_sources_ifdef(CONFIG_APP_DEAD_RECKONING app PRIVATE src/motion.c)

# OBD-II telemetry / fault codes over the K wire.
target_sources_ifdef(CONFIG_APP_KLINE_OBD app PRIVATE src/kline_obd.c)
# Threshold alerts on that telemetry (CONFIG_APP_OBD_ALERTS).
target_sources_ifdef(CONFIG_APP_KLINE_TELEMETRY app PRIVATE src/obd_alert.c)

target_include_directories(app PRIVATE src)
```

## sysbuild.conf
```
# Sysbuild image configuration.
#
# MCUboot is what makes over-the-air updates possible: src/fota.c streams the
# downloaded image into the secondary slot, MCUboot swaps it in on the next
# boot.  Default mode on the nRF91 is swap-using-move with ECDSA-P256
# signatures — no scratch partition, and the swap is revertible: the image is
# marked BOOT_UPGRADE_TEST, so if the new firmware never reaches
# boot_write_img_confirmed() (main.c, after init completes) MCUboot rolls back
# to the previous one on the following boot.
#
# Adding this splits the 1 MB flash into two 416 KB slots, pinned by
# pm_static.yml (TF-M and the application together are about 300 KB today),
# so the first build after this change must be flashed over SWD — a unit
# running a pre-MCUboot image cannot update itself into one.
SB_CONFIG_BOOTLOADER_MCUBOOT=y

# Signing key: mcuboot_priv.pem beside this file (gitignored).  build.sh passes
# its path to the build as SB_CONFIG_BOOT_SIGNATURE_KEY_FILE, and creates the
# key on the first bench build.
#
# KEEP A BACKUP of the private key: the public half is baked into every
# deployed bootloader, so losing it means no device already in the field can
# ever be updated again.
```

## prj.conf
```kconfig
# --- core ------------------------------------------------------------------
CONFIG_MAIN_STACK_SIZE=8192
# The system workqueue runs the modem's event handlers (the AT monitor, lte_lc
# and so the app's lte_handler).  On a network that grants PSM in the attach the
# PSM update is dispatched inline, nested in the registration handler, and the
# app's WRN for it then goes through the log core and the capture backend on
# that same stack: about 1.1 KB deep with immediate logging, against the 1152
# bytes it had, which overflowed (rst=sw+fatal:2).
CONFIG_SYSTEM_WORKQUEUE_STACK_SIZE=2048
# Kernel heap: lte_lc (handler list, pdn, ncellmeas) and getaddrinfo are the only
# k_malloc users, worst case about 2.5 KB (estimated, no measured peak).
CONFIG_HEAP_MEM_POOL_SIZE=8192
CONFIG_REBOOT=y
CONFIG_HWINFO=y

# --- logging ---------------------------------------------------------------
CONFIG_LOG=y
CONFIG_LOG_MODE_DEFERRED=y
# A send logs every record in the batch back to back (~300 bytes each) and
# the log thread only wakes on a 1 s timer or ten queued messages, so the
# default 1 KB buffer overflowed on every send and the core discarded the
# oldest lines.  Room for a whole burst, and wake the thread on a few
# messages rather than ten.
CONFIG_LOG_BUFFER_SIZE=4096
CONFIG_LOG_PROCESS_TRIGGER_THRESHOLD=3
# The log thread's 768 byte default is too small: the capture backend's
# repeat flush (two ~160 byte buffers plus vsnprintf) peaked at 776 bytes
# in a bench stress run, and a 768 byte image HardFaulted on the ordinary
# sleep-entry log burst with no crash note (TF-M's fault, plain rst=wdt).
CONFIG_LOG_PROCESS_THREAD_STACK_SIZE=2048
# log_stack_check() reads the log thread's unused stack (the 0xAA fill): watchdog.c.
CONFIG_INIT_STACKS=y
CONFIG_USE_SEGGER_RTT=n
CONFIG_SERIAL=y
CONFIG_UART_CONSOLE=y
CONFIG_LOG_BACKEND_UART=y
# Console UARTE is suspended across the sleep wait (console_suspend() in
# main.c) — left enabled it holds the HF clock for ~600-900 uA.
CONFIG_PM_DEVICE=y

# --- nRF modem -------------------------------------------------------------
CONFIG_NRF_MODEM_LIB=y
CONFIG_NRF_MODEM_LINK_BINARY=y
CONFIG_NRF_MODEM_LINK_BINARY_CELLULAR=y
CONFIG_LTE_LINK_CONTROL=y
# LTE-M only, plus GNSS.  NB-IoT is off, so the modem never falls back to it
# when LTE-M coverage drops: registration is simpler and quicker, at the cost
# of having no second RAT to reach for where LTE-M is unavailable.  The one
# exception is a parked unit whose LTE-M search has failed: modem.c switches
# to LTE-M + NB-IoT at run time until key-on (APP_NBIOT_PARKED_FALLBACK).
#
# Deliberately no CONFIG_LTE_MODE_PREFERENCE_* line.  Every preference symbol
# depends on one of the two dual-mode choices, so pairing one with a
# single-RAT mode is an unmet dependency and Kconfig drops it with a warning.
# lte_link_control then uses preference 0 (auto), which is what %XSYSTEMMODE
# takes when only one RAT is enabled.
CONFIG_LTE_NETWORK_MODE_LTE_M_GPS=y
# --- networking / sockets via the modem ------------------------------------
CONFIG_NETWORKING=y
CONFIG_NET_NATIVE=n
CONFIG_NET_SOCKETS=y
CONFIG_NET_SOCKETS_OFFLOAD=y
CONFIG_POSIX_API=y

# --- entropy / crypto ------------------------------------------------------
CONFIG_ENTROPY_GENERATOR=y
CONFIG_NRF_SECURITY=y
CONFIG_MBEDTLS=y
CONFIG_PSA_WANT_KEY_TYPE_CHACHA20=y
CONFIG_PSA_WANT_ALG_CHACHA20_POLY1305=y

# --- TLS (nRF Cloud A-GNSS uses HTTPS; modem key mgmt for its cert) -------
CONFIG_MODEM_KEY_MGMT=y

# --- RAI (Release Assistance Indication) -----------------------------------
CONFIG_LTE_LC_RAI_MODULE=y
CONFIG_LTE_RAI_REQ=y

# --- GPIO + watchdog -------------------------------------------------------
CONFIG_GPIO=y
CONFIG_TASK_WDT=y
CONFIG_TASK_WDT_HW_FALLBACK=y
CONFIG_WATCHDOG=y
# The hardware fallback is fed by a background timer every MIN_TIMEOUT, so
# this is also how often the CPU wakes during an engine-off sleep: the 100 ms
# default would be ten wakes a second for the whole sleep.  10 s is the
# maximum the symbol allows, and at that cadence the cost is a rounding error
# against 134 uA.  A frozen kernel is then reset within MIN_TIMEOUT + the
# fallback delay, and a stuck task within its own 32 s window plus that.
CONFIG_TASK_WDT_MIN_TIMEOUT=10000
CONFIG_TASK_WDT_HW_FALLBACK_DELAY=2000

# --- modem faults ----------------------------------------------------------
# A modem crash used to be logged and then ignored (the DO_NOTHING default):
# every modem call returned -NRF_ESHUTDOWN from then on, so the unit stayed
# awake and mute until something happened to reinitialise the library —
# modem_recover()'s 30-minute last resort, if it ever ran, or a reboot.  The
# reset thread does that reinitialisation within a second instead, and keeps
# the unsent telemetry a reboot would have thrown away.  STATE_IDLE brings
# the radio back up afterwards (modem_radio_up), which the reinit does not.
CONFIG_NRF_MODEM_LIB_ON_FAULT_RESET_MODEM=y
# Names the fault in the log line rather than printing a bare reason code;
# that line is an ERR, so dbglog carries it to the server.
CONFIG_NRF_MODEM_LIB_FAULT_STRERROR=y

# --- over-the-air updates (src/fota.c) -------------------------------------
# The libraries themselves are pulled in by CONFIG_APP_FOTA; MCUboot support
# in the app image comes from sysbuild.conf, and this makes the dependency
# explicit (boot_write_img_confirmed() etc.).
CONFIG_BOOTLOADER_MCUBOOT=y
CONFIG_DOWNLOADER_STACK_SIZE=4096

# --- printf with floats ----------------------------------------------------
CONFIG_CBPRINTF_FP_SUPPORT=y
CONFIG_REQUIRES_FULL_LIBC=y

# --- date-time (NTP fallback when NITZ is unavailable) --------------------
CONFIG_DATE_TIME=y
CONFIG_DATE_TIME_NTP=y

# --- nRF Cloud A-GNSS via REST --------------------------------------------
CONFIG_NRF_CLOUD=y
CONFIG_NRF_CLOUD_REST=y
CONFIG_NRF_CLOUD_AGNSS=y
CONFIG_MODEM_INFO=y
CONFIG_MODEM_INFO_ADD_NETWORK=y
CONFIG_MODEM_JWT=y

# --- application -----------------------------------------------------------
CONFIG_APP_APN="sensor.net"
CONFIG_APP_LOG_LEVEL=3

# --- Kconfig warning policy ------------------------------------------------
CONFIG_WARN_DEPRECATED=n
CONFIG_WARN_EXPERIMENTAL=n
```

## lte_power_test.conf
```kconfig
# LTE TX power / brown-out test overlay.  Replaces the tracker with a rig
# that idles with LED1 on and, on an ignition OFF->ON edge (or ENTER over the
# serial console, when USB is attached), pushes ~10 s of uplink UDP traffic
# through the modem flat-out — the sustained-TX supply load of a unit
# transmitting at full power in a low-signal area.  LED2 joins LED1 during
# the burst; surviving it lights all three LEDs, held until ignition is
# turned OFF (which also re-arms the trigger).  A brown-out resets the
# board, so LED3 never lights and the unit comes back up at LED1 only.
#
# The ignition trigger is the one to use when measuring current: USB takes
# over the power input, so the PSU-only run this test exists for has no
# serial console.  Flick the ignition wire for each burst (it must drop back
# to OFF before it re-arms); needs CONFIG_APP_DEBUG_IGNITION=-1.  Build with:
#
#   LTE_TEST=1 BUILD_SUBDIR=build_lte_test ./build.sh
#
# then flash build_lte_test/merged.hex.

CONFIG_APP_LTE_POWER_TEST=y
```

## makerdiary 2.conf
```kconfig
# Makerdiary nRF9151 Connect Kit — settings that apply to all Connect Kit
# builds (bench and PCB).  Bench-specific pin wiring is in Kconfig.boards
# (BOARD_NRF9151_CONNECTKIT defaults); per-PCB pin maps come from the
# APP_BOARD_* choice.
#
# Layered on top of prj.conf by build.sh when PROFILE=makerdiary.

# Onomondo SIM
CONFIG_APP_APN="sensor.net"

# GNSS antenna front-end.
# The Connect Kit's U.FL GNSS antenna feeds an onboard LNA whose supply (a
# TPS7A02 LDO) is enabled by the nRF9151's COEX0 pin.  COEX0 is only asserted
# in the GPS L1 band if the modem_antenna library sends AT%XCOEX0 at boot.
CONFIG_MODEM_ANTENNA=y
CONFIG_MODEM_ANTENNA_GNSS_ONBOARD=y
CONFIG_MODEM_ANTENNA_AT_COEX0="AT%XCOEX0=1,1,1565,1586"

CONFIG_APP_DEBUG_IGNITION=0
```

## prov.conf
```kconfig
# Provisioning-build overlay.  Turns the tracker app into an AT-host bridge so
# nrfcloud-utils can onboard the device to nRF Cloud over serial — no separate
# at_client sample needed.  Build with:
#
#   PROV=1 BUILD_DIR="$PWD/build_prov" ./build.sh pristine
#
# Flow:  flash build_prov/merged.hex
#   -> device_credentials_installer --cmd-type at --ca onboarding/*_ca.pem \
#          --ca-key onboarding/*_prv.pem --id-imei --id-str nrf- -d \
#          --csv onboarding/onboard.csv
#   -> nrf_cloud_onboard --api-key <KEY> --csv onboarding/onboard.csv
#   -> reflash the normal build (./build.sh)
# Credentials are written to modem NVM, so they survive reflashing.

CONFIG_APP_PROVISION_MODE=y

# AT Host library: pipes nrfcloud-utils (--cmd-type at) <-> modem (AT%KEYGEN…)
CONFIG_AT_HOST_LIBRARY=y
CONFIG_UART_INTERRUPT_DRIVEN=y

# Keep the console UART clean for the AT exchange (no interleaved log lines).
CONFIG_LOG=n
```

## boards/nrf9151_connectkit_nrf9151_ns.conf
```kconfig
# Makerdiary nRF9151 Connect Kit: applied by Zephyr to every build for the
# nrf9151_connectkit/nrf9151/ns target, bench and PCB alike.
#
# GNSS antenna front-end.  The Connect Kit's GNSS U.FL feeds an onboard LNA
# whose supply (a TPS7A02 LDO) is enabled by the nRF9151's COEX0 pin.  COEX0 is
# only asserted in the GPS L1 band once the modem_antenna library has sent
# AT%XCOEX0 at boot, and the board target does not turn the library on (only
# Nordic's own boards do), so without these lines GNSS sees no satellites.
CONFIG_MODEM_ANTENNA=y
CONFIG_MODEM_ANTENNA_GNSS_ONBOARD=y
CONFIG_MODEM_ANTENNA_AT_COEX0="AT%XCOEX0=1,1,1565,1586"
```

## boards/nrf9151dk_nrf9151_ns.conf
```kconfig
# Board-specific Kconfig for the nRF9151 DK.  Pin assignments live in
# Kconfig (APP_PIN_*) with production-PCB defaults — override per-bench in
# local.conf.
```

## boards/nrf9151dk_nrf9151_ns.overlay
```dts
/* The tracker drives I2C and the K-lines as plain GPIO on gpio0,
 * so any DK peripheral whose default pinctrl claims one of those pins must be
 * disabled to hand the pin back to the app.  (UART0 keeps its default pins
 * P0.14/15/26/27 — none of which the tracker uses — for the USB VCOM console.)
 */

/* I2C2 default pinctrl owns P0.30/P0.31 — needed for RLY_RST / IGN_SENSE. */
&i2c2 {
	status = "disabled";
};

/* SPI3 default pinctrl owns P0.11/P0.12 — needed for VBAT_ALRT / RLY_SET. */
&spi3 {
	status = "disabled";
};

/* Use DK-default UART0 pins (routed through J-Link to USB VCOM) */
&uart0 {
	status = "okay";
	current-speed = <115200>;
	/delete-property/ hw-flow-control;
};
```

## src/agnss.c
```c
/*
 * A-GNSS assistance data via nRF Cloud REST API.
 *
 * On cold start the modem fires NRF_MODEM_GNSS_EVT_AGNSS_REQ describing what
 * ephemeris/almanac/timing data it needs.  This module fetches that data from
 * nRF Cloud using the REST API, authenticated with a per-device JWT signed by
 * the key at CONFIG_NRF_CLOUD_SEC_TAG (the device must be onboarded to the
 * nRF Cloud account), then injects it via nrf_cloud_agnss_process().
 *
 * The nRF Cloud CA certificate (Amazon Root CA 1) is provisioned into the
 * modem on first boot at NRF_CLOUD_SEC_TAG.
 */

#include <string.h>
#include <errno.h>
#include <zephyr/kernel.h>
#include <zephyr/logging/log.h>
#include <zephyr/net/socket.h>
#include <modem/modem_key_mgmt.h>
#include <modem/modem_info.h>
#include <modem/modem_jwt.h>
#include <net/nrf_cloud_rest.h>
#include <net/nrf_cloud_agnss.h>

#include "app.h"
#include "modem_call_mark.h"

LOG_MODULE_REGISTER(agnss, CONFIG_APP_LOG_LEVEL);

#define NRF_CLOUD_SEC_TAG CONFIG_NRF_CLOUD_SEC_TAG

/* Amazon Root CA 1 — used by api.nrfcloud.com */
static const char ca_cert[] =
	"-----BEGIN CERTIFICATE-----\n"
	"MIIDQTCCAimgAwIBAgITBmyfz5m/jAo54vB4ikPmljZbyjANBgkqhkiG9w0BAQsF\n"
	"ADA5MQswCQYDVQQGEwJVUzEPMA0GA1UEChMGQW1hem9uMRkwFwYDVQQDExBBbWF6\n"
	"b24gUm9vdCBDQSAxMB4XDTE1MDUyNjAwMDAwMFoXDTM4MDExNzAwMDAwMFowOTEL\n"
	"MAkGA1UEBhMCVVMxDzANBgNVBAoTBkFtYXpvbjEZMBcGA1UEAxMQQW1hem9uIFJv\n"
	"b3QgQ0EgMTCCASIwDQYJKoZIhvcNAQEBBQADggEPADCCAQoCggEBALJ4gHHKeNXj\n"
	"ca9HgFB0fW7Y14h29Jlo91ghYPl0hAEvrAIthtOgQ3pOsqTQNroBvo3bSMgHFzZM\n"
	"9O6II8c+6zf1tRn4SWiw3te5djgdYZ6k/oI2peVKVuRF4fn9tBb6dNqcmzU5L/qw\n"
	"IFAGbHrQgLKm+a/sRxmPUDgH3KKHOVj4utWp+UhnMJbulHheb4mjUcAwhmahRWa6\n"
	"VOujw5H5SNz/0egwLX0tdHA114gk957EWW67c4cX8jJGKLhD+rcdqsq08p8kDi1L\n"
	"93FcXmn/6pUCyziKrlA4b9v7LWIbxcceVOF34GfID5yHI9Y/QCB/IIDEgEw+OyQm\n"
	"jgSubJrIqg0CAwEAAaNCMEAwDwYDVR0TAQH/BAUwAwEB/zAOBgNVHQ8BAf8EBAMC\n"
	"AYYwHQYDVR0OBBYEFIQYzIU07LwMlJQuCFmcx7IQTgoIMA0GCSqGSIb3DQEBCwUA\n"
	"A4IBAQCY8jdaQZChGsV2USggNiMOruYou6r4lK5IpDB/G/wkjUu0yKGX9rbxenDI\n"
	"U5PMCCjjmCXPI6T53iHTfIUJrU6adTrCC2qJeHZERxhlbI1Bjjt/msv0tadQ1wUs\n"
	"N+gDS63pYaACbvXy8MWy7Vu33PqUXHeeE6V/Uq2V8viTO96LXFvKWlJbYK8U90vv\n"
	"o/ufQJVtMVT8QtPHRh8jrdkPSHCa2XV4cdFyQzR1bldZwgJcJmApzyMZFo6IQ6XU\n"
	"5MsI+yMRQ+hDKXJioaldXgjUkK642M4UwtBV8ob2xJNDd2ZhwLnoQdeXeGADbkpy\n"
	"rqXRfboQnoZsG4q5WTP468SQvvG5\n"
	"-----END CERTIFICATE-----\n";

static char jwt_buf[600];
static char rx_buf[2048];
static char agnss_data_buf[NRF_CLOUD_AGNSS_MAX_DATA_SIZE];

static int provision_ca(void)
{
	int err;
	bool exists;

	err = modem_key_mgmt_exists(NRF_CLOUD_SEC_TAG,
				    MODEM_KEY_MGMT_CRED_TYPE_CA_CHAIN,
				    &exists);
	if (err) {
		LOG_ERR("key_mgmt_exists: %d", err);
		return err;
	}
	if (exists) {
		return 0;
	}

	err = modem_key_mgmt_write(NRF_CLOUD_SEC_TAG,
				   MODEM_KEY_MGMT_CRED_TYPE_CA_CHAIN,
				   ca_cert, sizeof(ca_cert) - 1);
	if (err) {
		LOG_ERR("key_mgmt_write: %d", err);
		return err;
	}
	LOG_INF("nRF Cloud CA provisioned (sec_tag %d)", NRF_CLOUD_SEC_TAG);
	return 0;
}

static int get_serving_cell(struct lte_lc_cell *cell)
{
	int err;
	char buf[MODEM_INFO_MAX_RESPONSE_SIZE];

	err = MCM_LTE(MCM_LTE_INFO, modem_info_string_get(MODEM_INFO_CELLID, buf, sizeof(buf)));
	if (err < 0) return err;
	cell->id = strtol(buf, NULL, 16);

	err = MCM_LTE(MCM_LTE_INFO, modem_info_string_get(MODEM_INFO_AREA_CODE, buf, sizeof(buf)));
	if (err < 0) return err;
	cell->tac = strtol(buf, NULL, 16);

	err = MCM_LTE(MCM_LTE_INFO, modem_info_string_get(MODEM_INFO_OPERATOR, buf, sizeof(buf)));
	if (err < 0) return err;
	cell->mnc = strtol(&buf[3], NULL, 10);
	buf[3] = '\0';
	cell->mcc = strtol(buf, NULL, 10);

	return 0;
}

/* The name lookup, asked first and with a deadline.  The modem's resolver can
 * sit on one query for tens of seconds when the link is marginal — 38 s on
 * 2026-10-24 at 19:30, on the road with the radio held by the network — and
 * the REST client only compares its timeout with the clock once
 * getaddrinfo() has returned, so the 20 s below never applied to it: the
 * fetch outlasted the 32 s watchdog window ("no kick for 32s", with the
 * hardware reset ten seconds behind) and returned a few seconds short of it.
 * Nothing to slice, so the lookup is asked from a thread of its own and
 * waited for in kicked one-second slices.  On a miss the attempt is dropped
 * before the receiver has been paused, and the thread finishes its query in
 * its own time; after a hit the REST call looks the same name up again, a
 * moment later. */
#define AGNSS_DNS_STACK_SIZE	1536

static K_SEM_DEFINE(s_dns_go, 0, 1);
static K_SEM_DEFINE(s_dns_done, 0, 1);
static atomic_t s_dns_busy;
static int s_dns_err;

static void dns_thread(void *p1, void *p2, void *p3)
{
	struct zsock_addrinfo hints = {
		.ai_flags = AI_NUMERICSERV,
		.ai_family = AF_UNSPEC,
		.ai_socktype = SOCK_STREAM,
	};

	ARG_UNUSED(p1);
	ARG_UNUSED(p2);
	ARG_UNUSED(p3);

	for (;;) {
		struct zsock_addrinfo *res = NULL;

		k_sem_take(&s_dns_go, K_FOREVER);
		s_dns_err = MCM_SOCK2(MCM_SOCK_DNS, zsock_getaddrinfo(CONFIG_NRF_CLOUD_REST_HOST_NAME,
					      "443", &hints, &res));
		if (res) {
			zsock_freeaddrinfo(res);
		}
		/* Done is given before busy is cleared, so a request that finds
		 * the thread idle cannot be handed the last one's answer. */
		k_sem_give(&s_dns_done);
		atomic_clear(&s_dns_busy);
	}
}

K_THREAD_DEFINE(s_dns_tid, AGNSS_DNS_STACK_SIZE, dns_thread, NULL, NULL, NULL,
		K_LOWEST_APPLICATION_THREAD_PRIO, 0, 0);

static int agnss_resolve(void)
{
	if (!atomic_cas(&s_dns_busy, 0, 1)) {
		LOG_WRN("nRF Cloud lookup from an earlier attempt still unanswered");
		return -EBUSY;
	}

	k_sem_reset(&s_dns_done);
	k_sem_give(&s_dns_go);

	for (int waited_ms = 0; waited_ms < AGNSS_DNS_WAIT_MS; waited_ms += 1000) {
		watchdog_kick();
		if (k_sem_take(&s_dns_done, K_SECONDS(1)) == 0) {
			if (s_dns_err) {
				LOG_WRN("getaddrinfo(%s): %d",
					CONFIG_NRF_CLOUD_REST_HOST_NAME, s_dns_err);
				return -EIO;
			}
			return 0;
		}
	}

	watchdog_kick();
	LOG_WRN("nRF Cloud lookup unanswered after %d s — A-GNSS dropped",
		AGNSS_DNS_WAIT_MS / 1000);
	return -ETIMEDOUT;
}

int agnss_init(void)
{
	int err = MCM_LTE(MCM_LTE_INFO, modem_info_init());
	if (err) {
		LOG_ERR("modem_info_init: %d", err);
		return err;
	}
	return provision_ca();
}

int agnss_fetch(void *agnss_request)
{
	struct nrf_modem_gnss_agnss_data_frame *request = agnss_request;

	/* JWT needs a valid modem clock for the expiry field.  The date_time
	 * library auto-triggers on LTE connect: tries NITZ first, falls back
	 * to NTP, and pushes the result to the modem via AT+CCLK. */
	int err = nrf_cloud_jwt_generate(0, jwt_buf, sizeof(jwt_buf));
	if (err) {
		/* Expected once per boot: the clock is not set until NITZ or
		 * NTP has run, and the retry below covers it. */
		LOG_INF("JWT needs modem time; waiting for NTP fallback...");
		for (int i = 0; i < 15; i++) {
			k_msleep(1000);
			watchdog_kick();
			err = nrf_cloud_jwt_generate(0, jwt_buf, sizeof(jwt_buf));
			if (!err) break;
		}
		if (err) {
			LOG_ERR("JWT generate failed: %d", err);
			return err;
		}
	}

	err = agnss_resolve();
	if (err) {
		return err;
	}

	struct nrf_cloud_rest_context rest_ctx = {
		.connect_socket = -1,
		.keep_alive = false,
		/* Inside the watchdog window (WATCHDOG_TIMEOUT_S): this is one
		 * blocking call that cannot be sliced, so it has to fit between
		 * two kicks rather than outlast them.  Its lookup is asked first,
		 * with a deadline of its own (agnss_resolve()), so this is the
		 * connect, the handshake and a few KB.  Ample with the radio
		 * handed to LTE below, and a miss is not fatal: gnss_collect()
		 * retries it (AGNSS_RETRIES) while the receiver keeps searching. */
		.timeout_ms = 20000,
		.auth = jwt_buf,
		.rx_buf = rx_buf,
		.rx_buf_len = sizeof(rx_buf),
		.fragment_size = 0,
	};

	struct nrf_cloud_rest_agnss_request req = {
		.type = request ? NRF_CLOUD_REST_AGNSS_REQ_CUSTOM
				: NRF_CLOUD_REST_AGNSS_REQ_ASSISTANCE,
		.agnss_req = request,
		.net_info = NULL,
		.mask_angle = NRF_CLOUD_AGNSS_MASK_ANGLE_NONE,
	};

	struct nrf_cloud_rest_agnss_result result = {
		.buf = agnss_data_buf,
		.buf_sz = sizeof(agnss_data_buf),
	};

	struct lte_lc_cells_info net_info = { 0 };
	if (get_serving_cell(&net_info.current_cell) == 0) {
		req.net_info = &net_info;
	}

	LOG_INF("requesting A-GNSS data from nRF Cloud...");

	/* GNSS and LTE share one RF front-end on the nRF91, so they cannot both
	 * have the radio.  A cold GNSS search wants long uninterrupted windows,
	 * which leaves a TLS handshake plus a multi-kilobyte download very
	 * little airtime — that is how this ends up timing out at 30 s and
	 * returning HTTP 0, having never reached the server at all.
	 *
	 * So hand the radio to LTE for the download.  gnss_stop() only reports
	 * success if the receiver was actually running, which is how the
	 * boot-time call (GNSS not started yet) knows to leave it alone.
	 * gnss_resume() rather than gnss_start(): the latter clears the
	 * have-fix state, which would turn a warm receiver cold. */
	bool paused = (gnss_stop() == 0);

	if (paused) {
		LOG_INF("GNSS paused for the download (shared RF front-end)");
	}

	watchdog_kick();
	err = nrf_cloud_rest_agnss_data_get(&rest_ctx, &req, &result);
	watchdog_kick();

	if (paused) {
		gnss_resume();
	}
	if (err) {
		LOG_ERR("agnss_data_get: %d (HTTP %d)", err, rest_ctx.status);
		return err;
	}

	LOG_INF("received %u bytes, processing", (unsigned)result.agnss_sz);

	err = nrf_cloud_agnss_process(result.buf, result.agnss_sz);
	if (err) {
		LOG_ERR("agnss_process: %d", err);
		return err;
	}

	LOG_INF("A-GNSS data injected");
	return 0;
}
```

## src/alert.c
```c
/*
 * Alert queue + dispatch.  Alerts piggyback on telemetry sends and are also
 * sent standalone after movement wakes.
 *
 * Held until answered.  transport_send() returning 0 means the modem took the
 * datagram, nothing more; the server's reply is the receipt (see databuf.c).
 * An alert used to be forgotten the moment the modem had it, so one sent just
 * before a network reject was simply lost: on 2026-09-30 the bench's
 * "backup power: 9.19V" went out at 19:55:19, the network rejected the
 * registration two seconds later (EMM cause 9, TAC 12296), and the server
 * never saw it.  Now an alert keeps its slot until the reply to the datagram
 * that carried it comes in.  One still unanswered after APP_ACK_TIMEOUT_S goes
 * out again with the next send, as does one still unanswered when the socket
 * is about to close (databuf_settle, which waits for these replies too).
 *
 * A reply can be lost when the alert was not, so an alert can arrive twice.
 * Each carries an id, ",aid=<n>" at the end of the line, and the server drops
 * a copy of one it has already relayed rather than notify again.  The ids are
 * consecutive from a random start, like rid=, so a reboot does not reuse the
 * previous boot's.  Only where there is a reply to wait for: Traccar's HTTP
 * 2xx is its own receipt, and its builds hold nothing (APP_DATABUF_UNACKED_
 * SLOTS = 0), so their alert lines are exactly what they were.
 *
 * Main thread only, like databuf.c: the queue is not locked.  A thread that has
 * something to report sets a flag for the main thread to raise the alert from
 * (gnss_ext.c does).
 */

#include <string.h>
#include <stdio.h>
#include <zephyr/logging/log.h>

#include "app.h"
#include "config.h"
#include "install.h"

LOG_MODULE_REGISTER(alert, CONFIG_APP_LOG_LEVEL);

#define ALERT_QUEUE_SIZE 8
#define ALERT_MSG_SIZE   120

#define ALERT_HOLD       (CONFIG_APP_DATABUF_UNACKED_SLOTS > 0)
#define ACK_TIMEOUT_MS   ((int64_t)CONFIG_APP_ACK_TIMEOUT_S * 1000)

enum alert_state {
    ALERT_FREE,
    ALERT_QUEUED,       /* waiting for a send */
    ALERT_SENT,         /* with the modem, waiting for the reply */
};

static struct {
    uint8_t  state;
    int8_t   prio;
    uint32_t aid;
    uint32_t sent_id;   /* the transport's id for the datagram that carried it */
    int64_t  sent_ms;
    char     msg[ALERT_MSG_SIZE];
} s_alert[ALERT_QUEUE_SIZE];

/* Alerts waiting for a send.  What callers test before bringing the radio up
 * for alert_send(): one already with the modem is not counted. */
int alert_count;

static uint32_t s_aid;

static uint32_t next_aid(void)
{
    if (s_aid == 0) {
        uint16_t seed = 0;

        if (!crypto_random((uint8_t *)&seed, sizeof(seed))) {
            seed = (uint16_t)k_uptime_get();
        }
        s_aid = seed ? seed : 1u;
    }
    return ++s_aid;
}

static void enqueue(const char *msg, int priority)
{
    int slot = -1;

    for (int i = 0; i < ALERT_QUEUE_SIZE; i++) {
        if (s_alert[i].state == ALERT_FREE) {
            slot = i;
            break;
        }
    }
    if (slot < 0) {
        LOG_WRN("queue full, dropping");
        return;
    }
    strncpy(s_alert[slot].msg, msg, ALERT_MSG_SIZE - 1);
    s_alert[slot].msg[ALERT_MSG_SIZE - 1] = '\0';
    s_alert[slot].prio = (int8_t)priority;
    s_alert[slot].aid = next_aid();
    s_alert[slot].state = ALERT_QUEUED;
    alert_count++;
#ifdef CONFIG_APP_DEMO_MODE
    /* The locate/tomtom replies carry the position in their text. */
    char masked[ALERT_MSG_SIZE];
    LOG_INF("queued: %s", demo_mask_coords(s_alert[slot].msg,
                                           strlen(s_alert[slot].msg),
                                           masked, sizeof(masked)));
#else
    LOG_INF("queued: %s", msg);
#endif
}

/* The one gate for installation mode: a unit being fitted raises no alerts
 * (what looks like a fault is mostly "not installed yet").  The install
 * check's own summary comes in through alert_enqueue_install(). */
void alert_enqueue(const char *msg, int priority)
{
    if (install_active()) {
        return;
    }
    enqueue(msg, priority);
}

#if IS_ENABLED(CONFIG_APP_INSTALL_MODE)
void alert_enqueue_install(const char *msg, int priority)
{
    enqueue(msg, priority);
}

/* Entering the mode: what was queued before it is not sent. */
void alert_drop_queued(void)
{
    for (int i = 0; i < ALERT_QUEUE_SIZE; i++) {
        if (s_alert[i].state == ALERT_QUEUED) {
            s_alert[i].state = ALERT_FREE;
            alert_count--;
        }
    }
}
#endif

/* The queued alert raised first, or -1: sent in the order they were raised. */
static int next_queued(void)
{
    int best = -1;

    for (int i = 0; i < ALERT_QUEUE_SIZE; i++) {
        if (s_alert[i].state == ALERT_QUEUED &&
            (best < 0 || (int32_t)(s_alert[i].aid - s_alert[best].aid) < 0)) {
            best = i;
        }
    }
    return best;
}

/* Back in the queue for the next send. */
static void requeue(int i, const char *why)
{
    LOG_WRN("alert #%u unanswered %s - sending it again", s_alert[i].aid, why);
    s_alert[i].state = ALERT_QUEUED;
    alert_count++;
}

int alert_send(void)
{
    alert_expire();

    int i;

    while ((i = next_queued()) >= 0) {
        char line[ALERT_MSG_SIZE + 32];
        int n = ALERT_HOLD
            ? snprintf(line, sizeof(line), "A,%d,%s,aid=%u",
                       s_alert[i].prio, s_alert[i].msg, s_alert[i].aid)
            : snprintf(line, sizeof(line), "A,%d,%s",
                       s_alert[i].prio, s_alert[i].msg);

        if (n <= 0) {
            s_alert[i].state = ALERT_FREE;      /* cannot happen */
            alert_count--;
            continue;
        }
        if (transport_send((const uint8_t *)line, (size_t)n) != 0) {
            /* The rest stay queued for the next attempt. */
            return 0;
        }
        alert_count--;

        uint32_t id = transport_sent_id();

        if (ALERT_HOLD && id != 0) {
            s_alert[i].state = ALERT_SENT;
            s_alert[i].sent_id = id;
            s_alert[i].sent_ms = k_uptime_get();
        } else {
            /* No reply to wait for: the send was its own receipt. */
            s_alert[i].state = ALERT_FREE;
        }
    }
    return 1;
}

int alert_send_standalone(void)
{
    /* In the original firmware this also handled modem wake-up; here the
     * transport layer brings the socket up on demand.  Nothing else is going
     * out, and the caller takes the radio down straight after, so wait here
     * for the replies that say the alerts arrived — normally a second or so.
     * Any still unanswered go again with a later send. */
    int ok = alert_send();
    int64_t deadline = k_uptime_get() + RESPONSE_TIMEOUT_MS;

    while (alert_unanswered() > 0 && k_uptime_get() < deadline) {
        if (transport_poll() < 0) {
            break;                              /* no socket to hear it on */
        }
        if (alert_unanswered() > 0) {
            k_msleep(100);
        }
    }
    return ok;
}

void alert_ack(uint32_t id)
{
    for (int i = 0; i < ALERT_QUEUE_SIZE; i++) {
        if (s_alert[i].state == ALERT_SENT && s_alert[i].sent_id == id) {
            LOG_DBG("alert #%u answered", s_alert[i].aid);
            s_alert[i].state = ALERT_FREE;
        }
    }
}

int alert_unanswered(void)
{
    int n = 0;

    for (int i = 0; i < ALERT_QUEUE_SIZE; i++) {
        if (s_alert[i].state == ALERT_SENT) {
            n++;
        }
    }
    return n;
}

void alert_expire(void)
{
    int64_t now = k_uptime_get();

    for (int i = 0; i < ALERT_QUEUE_SIZE; i++) {
        if (s_alert[i].state == ALERT_SENT &&
            now - s_alert[i].sent_ms >= ACK_TIMEOUT_MS) {
            requeue(i, "past the timeout");
        }
    }
}

void alert_settle(void)
{
    for (int i = 0; i < ALERT_QUEUE_SIZE; i++) {
        if (s_alert[i].state == ALERT_SENT) {
            requeue(i, "as the socket closes");
        }
    }
}
```

## src/assistnow.c
```c
/*
 * u-blox AssistNow for the external receiver.
 *
 * A receiver that has sat unpowered for hours holds no usable ephemerides and
 * must read them from the satellites: 25 to 30 s with a clear sky, minutes
 * with a poor one.  AssistNow Predictive Orbits (free from u-blox) tells it
 * where the satellites will be for the coming days, so it need only hear a few
 * of them.
 *
 * This does not talk to u-blox.  The l0destar server does: it registers each
 * receiver with the service, downloads the orbits once a day, keeps them, and
 * serves this unit the part it can use (server/tracker/assistnow.py).  Between
 * them a reboot or a firmware update loses nothing, u-blox's request limit per
 * device is never what runs out, and the credential for the service stays on
 * the server and out of the firmware image.
 *
 * The receiver driver (gnss_ext.c) asks for assistance when the receiver comes
 * up with fewer than a handful of ephemerides and no fix.  A thread of its own
 * then:
 *
 *   1. waits for the network and for the receiver's chip id and version
 *      replies (UBX-SEC-UNIQID, UBX-MON-VER), which the driver has asked for;
 *   2. GETs /assist/data.bin from the update server, over the same TLS as the
 *      firmware manifest.  A 404 means the server has not met this receiver:
 *      it is registered with GET /assist/register, which carries those two
 *      replies, and the data is asked for again;
 *   3. hands the receiver the time from the modem's clock, then the data as
 *      the server sent it (UBX-MGA messages and nothing else gets through,
 *      gnss_ext_assist_inject), and logs how many it took.
 *
 * It runs on a thread so that a slow name lookup or a weak link, which can
 * hold a request for its whole timeout, cannot hold the main loop past the
 * watchdog.
 */

#include <errno.h>
#include <stdarg.h>
#include <stdio.h>
#include <string.h>
#include <zephyr/kernel.h>
#include <zephyr/logging/log.h>
#include <zephyr/net/tls_credentials.h>
#include <date_time.h>
#include <net/rest_client.h>

#include "app.h"
#include "assistnow.h"
#include "gnss_ubx.h"

LOG_MODULE_REGISTER(assistnow, CONFIG_APP_LOG_LEVEL);

/* The same endpoint as the firmware manifest: the update server's TLS listener
 * and the CA at the same sec_tag. */
#define ASSIST_HOST                                                            \
    (sizeof(CONFIG_APP_FOTA_HOST) > 1                                          \
         ? CONFIG_APP_FOTA_HOST                                                \
         : (sizeof(CONFIG_APP_SERVER_HOST) > 1 ? CONFIG_APP_SERVER_HOST        \
                                               : HOSTNAME))
#define ASSIST_SEC_TAG      CONFIG_APP_FOTA_SEC_TAG
#define ASSIST_USE_TLS      (ASSIST_SEC_TAG >= 0)

#define STACK_SIZE          3072
#define THREAD_PRIO         K_PRIO_PREEMPT(10)
#define NETWORK_WAIT_MS     90000       /* for LTE, before the attempt is given up */
#define IDS_WAIT_MS         10000       /* for the receiver's chip id and version replies */
#define CLOCK_WAIT_MS       30000       /* for the modem's clock */
#define RETRY_PAUSE_MS      20000       /* between the two attempts */
#define HEADERS_ROOM        512         /* of the buffer, for the response's headers */

static K_SEM_DEFINE(s_req, 0, 1);

static char s_buf[CONFIG_APP_ASSISTNOW_BUF_SIZE];
/* Request line; the registration one carries the version reply as hex, about
 * 480 characters (the buffer takes the longest the driver keeps, 400 bytes). */
static char s_url[1024];
static char s_status[72] = "idle";

const char *assistnow_status(void)
{
    return s_status;
}

static void status(const char *fmt, ...) __printf_like(1, 2);

static void status(const char *fmt, ...)
{
    va_list ap;

    va_start(ap, fmt);
    vsnprintf(s_status, sizeof(s_status), fmt, ap);
    va_end(ap);
}

void assistnow_request(void)
{
    k_sem_give(&s_req);
}

/* One GET to the update server.  0 with *code set if the server answered at
 * all, whatever it said; the body, if any, is in s_buf at *body. */
static int http_get(const char *url, unsigned *code, const uint8_t **body, size_t *blen)
{
    struct rest_client_req_context req = {0};
    struct rest_client_resp_context resp = {0};

    rest_client_request_defaults_set(&req);
    req.http_method   = HTTP_GET;
    req.host          = ASSIST_HOST;
    req.port          = CONFIG_APP_FOTA_PORT;
    req.url           = url;
    req.sec_tag       = ASSIST_USE_TLS ? ASSIST_SEC_TAG : SEC_TAG_TLS_INVALID;
    req.timeout_ms    = CONFIG_APP_ASSISTNOW_TIMEOUT_S * MSEC_PER_SEC;
    req.resp_buff     = s_buf;
    req.resp_buff_len = sizeof(s_buf);

    int err = rest_client_request(&req, &resp);

    if (err) {
        return err;
    }
    *code = resp.http_status_code;
    *body = (const uint8_t *)resp.response;
    *blen = resp.response ? resp.response_len : 0;
    return 0;
}

/* Tell the server this receiver exists.  Its answer is the HTTP status:
 * 200 registered; 403 the server will not (this IMEI is registered with
 * another receiver, or assistance is off for it); 502/503 the service itself
 * would not. */
static int register_unit(const char *imei)
{
    char uid[48];
    int err = -EAGAIN;
    size_t p = (size_t)snprintf(s_url, sizeof(s_url), "/assist/register?imei=%s&ver=", imei);

    for (int64_t until = k_uptime_get() + IDS_WAIT_MS; k_uptime_get() < until; k_msleep(500)) {
        /* The version reply goes straight into the request line. */
        err = gnss_ext_ids(uid, sizeof(uid), s_url + p, sizeof(s_url) - p - 80);
        if (err != -EAGAIN || !gnss_ext_assist_useful()) {
            break;
        }
    }
    if (err) {
        LOG_WRN("receiver ids not available: %d", err);
        return err == -EAGAIN ? -ETIMEDOUT : err;
    }
    p += strlen(s_url + p);
    snprintf(s_url + p, sizeof(s_url) - p, "&uid=%s", uid);

    unsigned code;
    const uint8_t *body;
    size_t blen;

    status("registering the receiver");
    err = http_get(s_url, &code, &body, &blen);
    if (err) {
        LOG_WRN("registration request failed: %d", err);
        return err;
    }
    if (code == 200) {
        LOG_INF("receiver registered with the server");
        return 0;
    }
    LOG_WRN("registration refused: HTTP %u", code);
    return code == 403 ? -EACCES : -EIO;
}

/* The modem's clock as a UBX time message.  The clock comes from the network
 * a few seconds after registration, so it is waited for. */
static int time_frame(uint8_t *f, size_t cap)
{
    int64_t ms = 0;
    int err = -ENODATA;

    for (int64_t until = k_uptime_get() + CLOCK_WAIT_MS; k_uptime_get() < until; k_msleep(500)) {
        err = date_time_now(&ms);
        if (err == 0 || !gnss_ext_assist_useful()) {
            break;
        }
    }
    if (err) {
        return 0;
    }
    return (int)ubx_build_mga_ini_time_unix(f, cap, ms, CONFIG_APP_ASSISTNOW_TIME_ACC_S);
}

/* The time, then what the server sent, into the receiver. */
static int deliver(const uint8_t *data, size_t len)
{
    struct gnss_assist_result rt = {0}, rb = {0};
    uint8_t f[40];
    int n = time_frame(f, sizeof(f));
    int err = 0;

    if (!gnss_ext_assist_useful()) {
        return -ECANCELED;              /* a fix, or the rail dropped, while it was fetched */
    }
    status("giving the receiver %u bytes", (unsigned)len);
    if (n > 0) {
        err = gnss_ext_assist_inject(f, (size_t)n, &rt);
    } else {
        LOG_WRN("no valid clock: the receiver is given the orbits without the time");
    }
    if (!err) {
        err = gnss_ext_assist_inject(data, len, &rb);
    }
    gnss_ext_assist_done();

    LOG_INF("assistance given: time %s, %u of %u messages taken, %u refused%s",
            rt.accepted ? "taken" : (n > 0 ? "not acknowledged" : "not sent"),
            rb.accepted, rb.sent, rb.refused,
            rb.first_info == 1 ? " (it did not know the time)" : "");
    status("given: %u of %u taken", rb.accepted, rb.sent);
    return err;
}

/* One try: ask the server for the data, registering first if it does not
 * know this receiver. */
static int fetch_and_inject(void)
{
    if (!g_settings.imei[0]) {
        return -ENODATA;
    }

    for (int round = 0; round < 2; round++) {
        unsigned code;
        const uint8_t *body;
        size_t blen;

        snprintf(s_url, sizeof(s_url), "/assist/data.bin?imei=%s&gnss=%s&max=%u",
                 g_settings.imei, CONFIG_APP_ASSISTNOW_GNSS,
                 (unsigned)(sizeof(s_buf) - HEADERS_ROOM));
        status("asking the server for orbits");

        int err = http_get(s_url, &code, &body, &blen);

        if (err) {
            LOG_WRN("request failed: %d", err);
            return err;
        }
        switch (code) {
        case 200:
            if (blen == 0) {
                return -EAGAIN;
            }
            return deliver(body, blen);
        case 404:                       /* not registered */
            if (round > 0) {
                return -ENOENT;
            }
            err = register_unit(g_settings.imei);
            if (err) {
                return err;
            }
            break;                      /* and ask again */
        case 204:                       /* registered; the server has none yet */
            LOG_INF("the server has no orbits for this receiver yet");
            return -EAGAIN;
        default:
            LOG_WRN("data request: HTTP %u", code);
            return code == 501 ? -ENOTSUP : -EIO;
        }
    }
    return -EIO;
}

static int attempt(void)
{
    /* LTE first.  It is normally up by the time the receiver has been
     * configured, but a unit that woke on movement may still be attaching. */
    for (int64_t until = k_uptime_get() + NETWORK_WAIT_MS;
         !modem_is_registered(); k_msleep(1000)) {
        if (!gnss_ext_assist_useful() || k_uptime_get() > until) {
            return -ENETDOWN;
        }
        status("waiting for the network");
    }

    for (int tries = 0; tries < 2; tries++) {
        if (!gnss_ext_assist_useful()) {
            return -ECANCELED;
        }

        int err = fetch_and_inject();

        if (err == 0 || err == -ECANCELED || err == -EACCES || err == -ENOTSUP) {
            return err;                 /* done, pointless, or refused for good */
        }
        LOG_INF("assistance attempt %d failed: %d", tries + 1, err);
        if (tries == 0) {
            status("retrying after %d", err);
            k_msleep(RETRY_PAUSE_MS);
        } else {
            return err;
        }
    }
    return -EIO;
}

static void worker(void *a, void *b, void *c)
{
    ARG_UNUSED(a);
    ARG_UNUSED(b);
    ARG_UNUSED(c);

    for (;;) {
        k_sem_take(&s_req, K_FOREVER);

        int err = attempt();

        if (err) {
            /* Not retried this power-up: the receiver finds its own way, as it
             * does without any of this, and the next power-up asks again. */
            status("not given: %d", err);
            if (err != -ECANCELED) {
                LOG_WRN("no assistance this power-up: %d", err);
            }
            gnss_ext_assist_done();
        }
    }
}

K_THREAD_DEFINE(assistnow_thread, STACK_SIZE, worker, NULL, NULL, NULL, THREAD_PRIO, 0, 0);
```

## src/assistnow.h
```c
/*
 * u-blox AssistNow for the external receiver (assistnow.c).
 *
 * The receiver driver (gnss_ext.c) decides when assistance is wanted and owns
 * the UART; assistnow.c fetches the data from the l0destar server and has the
 * driver pass it on.  Only the external receiver is assisted: the nRF9151's
 * own gets its assistance from nRF Cloud (agnss.c).
 */
#ifndef ASSISTNOW_H_
#define ASSISTNOW_H_

#include <stdbool.h>
#include <stddef.h>
#include <stdint.h>

/* What reached the receiver, from its UBX-MGA-ACK replies. */
struct gnss_assist_result {
    uint16_t sent;          /* assistance messages written to the receiver */
    uint16_t accepted;      /* ... that it acknowledged as taken */
    uint16_t refused;       /* ... and as not used (UBX-MGA-ACK type 0) */
    uint8_t  first_info;    /* infoCode of the first refusal; 1: it did not know the time */
};

#ifdef CONFIG_APP_ASSISTNOW

/* The driver's side of it, in gnss_ext.c. */

/* The receiver's replies to the chip id (UBX-SEC-UNIQID) and version
 * (UBX-MON-VER) polls, byte for byte as hex, which is how the service wants
 * them.  0, or -EAGAIN while either has yet to arrive, -ENOSPC if a buffer is
 * too small (the version reply is about 240 bytes). */
int  gnss_ext_ids(char *uid_hex, size_t uid_sz, char *ver_hex, size_t ver_sz);
/* The receiver is up, configured, has no fix and has not been assisted this
 * power-up. */
bool gnss_ext_assist_useful(void);
/* Send the UBX-MGA messages in `data` to the receiver, a few at a time with
 * the acknowledgements watched, and wait for the last of them.  Only
 * assistance goes through: any other frame in the data, and anything that
 * does not check out, is skipped.  Blocks for a few seconds.  0, or -ENODEV
 * if the receiver went away, -EIO if the UART refused. */
int  gnss_ext_assist_inject(const uint8_t *data, size_t len, struct gnss_assist_result *res);
/* Assistance is done for this power-up (given, or given up on). */
void gnss_ext_assist_done(void);

/* From the driver's thread: the receiver has come up without ephemerides.
 * Does not block; the work is done on assistnow.c's own thread. */
void assistnow_request(void);

/* One line on where it stands, for the log and the board test. */
const char *assistnow_status(void);

#else

static inline void assistnow_request(void) {}

#endif /* CONFIG_APP_ASSISTNOW */

#endif /* ASSISTNOW_H_ */
```

## src/backup_log.h
```c
/*
 * The changes of the GNSS receiver's backup supply (V_BCKP) not yet reported
 * to the server.  A change happens while the unit sleeps (the overnight
 * cut-off) and is only reported by the next record, hours later, so each is
 * kept with when it happened and sent as its age: bk=<state>:<age_s>, several
 * joined by '|', oldest first.  The server files each at the record's time
 * minus the age.  Pure code, checked on the host: tests/test_backup_log.py.
 */
#ifndef BACKUP_LOG_H
#define BACKUP_LOG_H

#include <stddef.h>
#include <stdint.h>
#include <stdio.h>
#include <string.h>

/* Enough for a cut-off and its return across a few unsent days. */
#define BKLOG_MAX 6

/* "1:4294967|" is the longest an entry gets. */
#define BKLOG_BUF (BKLOG_MAX * 12 + 1)

struct bklog {
	uint8_t n;
	uint8_t state[BKLOG_MAX];
	int64_t at_ms[BKLOG_MAX];
};

/* Note a change.  The same state as the newest entry adds nothing; a full
 * list loses its oldest. */
static inline void bklog_add(struct bklog *l, int state, int64_t now_ms)
{
	if (l->n > 0 && l->state[l->n - 1] == (state != 0)) {
		return;
	}
	if (l->n == BKLOG_MAX) {
		for (int i = 1; i < BKLOG_MAX; i++) {
			l->state[i - 1] = l->state[i];
			l->at_ms[i - 1] = l->at_ms[i];
		}
		l->n--;
	}
	l->state[l->n] = (state != 0);
	l->at_ms[l->n] = now_ms;
	l->n++;
}

/* Write the entries as "<state>:<age_s>|..." into buf.  Returns how many were
 * written, which is how many to bklog_drop() once the text is in a record
 * that is on its way; 0 leaves buf empty.  An entry that does not fit stops
 * the list there, to go with the next record. */
static inline int bklog_format(const struct bklog *l, int64_t now_ms,
			       char *buf, size_t size)
{
	size_t used = 0;
	int done = 0;

	if (size > 0) {
		buf[0] = '\0';
	}
	for (int i = 0; i < l->n; i++) {
		int64_t age = (now_ms - l->at_ms[i]) / 1000;
		char item[24];
		int len;

		if (age < 0) {
			age = 0;
		}
		len = snprintf(item, sizeof(item), "%s%d:%lld", i ? "|" : "",
			       l->state[i], (long long)age);
		if (len < 0 || used + len + 1 > size) {
			break;
		}
		memcpy(buf + used, item, len + 1);
		used += len;
		done++;
	}
	return done;
}

/* Forget the first n entries: they went out. */
static inline void bklog_drop(struct bklog *l, int n)
{
	if (n <= 0) {
		return;
	}
	if (n >= l->n) {
		l->n = 0;
		return;
	}
	for (int i = n; i < l->n; i++) {
		l->state[i - n] = l->state[i];
		l->at_ms[i - n] = l->at_ms[i];
	}
	l->n -= n;
}

#endif
```

## src/ca_cert.h
```c
#ifndef CA_CERT_H
#define CA_CERT_H

static const char ca_cert_pem[] =
"-----BEGIN CERTIFICATE-----\n"
"MIIBgDCCASegAwIBAgIUGsaWzNBNlQpcPpKry6LPYakLlv8wCgYIKoZIzj0EAwIw\n"
"FjEUMBIGA1UEAwwLbDBkZXN0YXIgQ0EwHhcNMjYwNjA5MTEyMTQ1WhcNMzYwNjA2\n"
"MTEyMTQ1WjAWMRQwEgYDVQQDDAtsMGRlc3RhciBDQTBZMBMGByqGSM49AgEGCCqG\n"
"SM49AwEHA0IABA9bATdkhlS1Gn+JJoft1abvuOe8CW1gZ87QFVVgWRMCkJrEiXJM\n"
"ZYaB/710ztOyOm42UfgbH5CX8g4TI6Gzn3SjUzBRMB0GA1UdDgQWBBSCAiz4n4ua\n"
"ovjLNHk1JxBXbcqtcDAfBgNVHSMEGDAWgBSCAiz4n4uaovjLNHk1JxBXbcqtcDAP\n"
"BgNVHRMBAf8EBTADAQH/MAoGCCqGSM49BAMCA0cAMEQCIEsKbQCe64ZOxeTZFpsk\n"
"juP5RLWwdEl8tTDEJ2jVUq1CAiAoB/y0C4cK+9QAA1GBKQ1qi49aarUnrK0ajWjM\n"
"dVc1Dg==\n"
"-----END CERTIFICATE-----\n"
;

#endif
```
